## sound/soc/s3c/Kconfig
```kconfig
config SND_S5P_SOC
	tristate "Samsung SoC Audio"
	depends on ARCH_S5PC1XX || ARCH_S5PC11X || ARCH_S5P64XX
	help
	  Say Y or M if you want to add support for codecs attached to
	  the S3C AC97, I2S or SSP interface. You will also need
	  to select the audio interfaces to support below.

config SND_S3C_I2S_V50
	tristate

config SND_S3C_AC97
	tristate
config SND_S3C_PCMDEV
	tristate

config  SND_C110_PCM
        tristate "PCM-wm8994 device"
        depends on ARCH_S5PC11X && SND_UNIVERSAL_WM8994
        select SND_S3C_PCMDEV
       select SND_SOC_WM8994_PCM

choice
	prompt "Select the codec driver"
	depends on SND_S5P_SOC

config  SND_SMDKC110_WM8580
	tristate "WM8580-I2S on SMDKC110"
	depends on ARCH_S5PC11X
	select SND_S3C_I2S_V50
	select SND_SOC_WM8580

config  SND_UNIVERSAL_WM8994
	tristate "WM8994-I2S on UNIVERSAL"
	depends on ARCH_S5PC11X
	select SND_S3C_I2S_V50
	select SND_SOC_WM8994

config	SND_UNIVERSAL_WM8994_MASTER
	bool "WM8994 master"
	depends on SND_UNIVERSAL_WM8994
	default y

config  SND_SMDKC100_WM8580
	tristate "WM8580-I2S on SMDKC100"
	depends on ARCH_S5PC1XX
	select SND_S3C_I2S_V50
	select SND_SOC_WM8580

config  SND_SMDKC110_WM8580_PCM
	tristate "WM8580-PCM on SMDKC110"
	depends on ARCH_S5PC11X
	select SND_S3C_PCMDEV
	select SND_SOC_WM8580_PCM 

config  SND_SMDKC100_S5M8751
	tristate "S5M8751-I2S on SMDKC100"
	depends on ARCH_S5PC1XX
	select SND_S3C_I2S_V32
	select SND_SOC_S5M8751

config  SND_SMDKC100_WM9713
	tristate "WM9713-AC97 on SMDKC100"
	depends on ARCH_S5PC1XX
	select SND_S3C_AC97
	select SND_SOC_WM9713

config SND_S5PC100_SOC_UNIVERSAL_AK4671
	tristate "SoC I2S Audio support for UNIVERSAL - AK4671"
	depends on ARCH_S5PC1XX
	select SND_S3C_I2S_V50
	select SND_SOC_AK4671
	select SND_SOC_MAX9877
	help
	  Say Y if you want to add support for SoC audio on universal
	  with the AK4671.

config	SND_VOODOO_SOUND
	bool "Voodoo sound"
	depends on SND_ARIES_SOC_WM8994
	default y
	help
	  Say Y if you want to activate Voodoo sound extensions
	  like the headphone amp gain hardware control

config	SND_VOODOO_SOUND_HEADPHONE_AMP_GAIN
	bool "Headphone amp gain control"
	depends on SND_VOODOO_SOUND
	default y
	help
          Say Y if you want to activate control of the headphone gain through
	  the sysfs interface

config	SND_VOODOO_SOUND_RETUNE_EQ
	bool "ReTune parametric hardware equalizer"
	depends on SND_VOODOO_SOUND
	default y
	help
	  Say Y if you want to activate Wolfson ReTune paremetric hardware
	  equalizer controls

config	SND_VOODOO_SOUND_WM8994_WRITE
	bool "Expose the wm8994_write function"
	depends on SND_VOODOO_SOUND
	default n
	help
	  Say Y if you want to be able to send abritrary commands to the
	  WM8994 sound codec through the sysfs interface
	  This option is dangerous and should be used only carefuly after
	  some serious specsheet reading.

config	SND_VOODOO_SOUND_WM8994_REGISTER_DUMP
	bool "wm8994_register_dump on read operations on wm8994_write"
	depends on SND_VOODOO_SOUND_WM8994_WRITE
	default y
	help
	  Say Y if you want to be able to dump WM8994 codec's registers
	  to dmesg


config  SND_SMDK6442_WM8580
	tristate "WM8580-I2S on SMDK6442"
	depends on ARCH_S5P64XX
	select SND_S3C_I2S_V50
	select SND_SOC_WM8580

endchoice

config  SND_WM8580_MASTER
	bool "WM8580 Codec is I2S Master"
	depends on SND_SMDKC110_WM8580 || SND_SMDKC100_WM8580 || SND_SMDK6442_WM8580
	default n
```
